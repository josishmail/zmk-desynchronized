## config/boards/shields/Kconfig.defconfig
```kconfig
if SHIELD_DESYNCHRONIZED_LEFT

config ZMK_KEYBOARD_NAME
	default "Desynchronized"

config ZMK_SPLIT_ROLE_CENTRAL
	default y

endif

if SHIELD_DESYNCHRONIZED_LEFT || SHIELD_DESYNCHRONIZED_RIGHT

config SPI
	default y

config ZMK_SPLIT
	default y

endif
```

## config/boards/shields/Kconfig.shield
```kconfig
config SHIELD_DESYNCHRONIZED_LEFT
   def_bool $(shields_list_contains,desynchronized_left)

config SHIELD_DESYNCHRONIZED_RIGHT
   def_bool $(shields_list_contains,desynchronized_right)
```

## config/boards/shields/desynchronized/Kconfig.defconfig
```kconfig
if SHIELD_DESYNCHRONIZED_LEFT

config ZMK_KEYBOARD_NAME
	default "Desynchronized (Left)"

config ZMK_SPLIT_ROLE_CENTRAL
	default y

endif

if SHIELD_DESYNCHRONIZED_RIGHT

config ZMK_KEYBOARD_NAME
	default "Desynchronized (Right)"

endif

if SHIELD_DESYNCHRONIZED_LEFT || SHIELD_DESYNCHRONIZED_RIGHT

config SPI
	default y

config ZMK_SPLIT
	default y

endif
```

## config/west.yml
```yaml
manifest:
  remotes:
    - name: zmk
      url-base: https://github.com/josishmail
  projects:
    - name: zmk
      remote: zmk
      revision: support-trackball
      import: app/west.yml
  self:
    path: config
```
